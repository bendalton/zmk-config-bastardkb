## boards/shields/bastardkb/Kconfig.defconfig
```kconfig
if SHIELD_BASTARDKB_LEFT

config ZMK_KEYBOARD_NAME
	default "BastardKB Left"

config ZMK_SPLIT_BLE_ROLE_CENTRAL
	default y

endif

if SHIELD_BASTARDKB_RIGHT

config ZMK_KEYBOARD_NAME
	default "BastardKB Right"

endif

if SHIELD_BASTARDKB_LEFT || SHIELD_BASTARDKB_RIGHT

config ZMK_SPLIT
	default y

endif
```

## boards/shields/bastardkb/Kconfig.shield
```kconfig
# Copyright (c) 2020 Pete Johanson
# SPDX-License-Identifier: MIT

config SHIELD_BASTARDKB_LEFT
	def_bool $(shields_list_contains,bastardkb_left)

config SHIELD_BASTARDKB_RIGHT
	def_bool $(shields_list_contains,bastardkb_right)
```
